## Assignments/02-EmbeddedLinux/08-Buildroot/helloworld/Config.in
```kconfig
config BR2_PACKAGE_HELLOWORLD
	bool "helloworld"
	help
		A friendly program that prints helloworld
```

## Assignments/02-EmbeddedLinux/09-Yocto/02-BuildingImage/conf/bblayers.conf
```bitbake
# POKY_BBLAYERS_CONF_VERSION is increased each time build/conf/bblayers.conf
# changes incompatibly
POKY_BBLAYERS_CONF_VERSION = "2"

BBPATH = "${TOPDIR}"
BBFILES ?= ""

BBLAYERS ?= " \
  /home/taqi/poky/meta \
  /home/taqi/poky/meta-poky \
  /home/taqi/poky/meta-yocto-bsp \
  /home/taqi/meta-raspberrypi \
  /home/taqi/meta-openembedded/meta-oe \
  /home/taqi/meta-openembedded/meta-python \
  /home/taqi/meta-openembedded/meta-networking\
  /home/taqi/meta-openembedded/meta-multimedia \
  "
```

## Assignments/02-EmbeddedLinux/09-Yocto/03-AddingCustomLayer/my-custom-layer/meta-taqi/conf/layer.conf
```bitbake
# We have a conf and classes directory, add to BBPATH
BBPATH .= ":${LAYERDIR}"

# We have recipes-* directories, add to BBFILES
BBFILES += "${LAYERDIR}/recipes-*/*/*.bb \
            ${LAYERDIR}/recipes-*/*/*.bbappend"

BBFILE_COLLECTIONS += "meta-taqi"
BBFILE_PATTERN_meta-taqi = "^${LAYERDIR}/"
BBFILE_PRIORITY_meta-taqi = "6"

LAYERDEPENDS_meta-taqi = "core"
LAYERSERIES_COMPAT_meta-taqi = "dunfell"
```
